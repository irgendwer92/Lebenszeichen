## firmware/esp-idf/lebenszeichen/Kconfig
```kconfig
menu "Lebenszeichen"

config LZ_ALLOW_HTTP
    bool "Allow http:// relays (development only)"
    default n
    help
        Accept relay addresses with http:// as well as https://, for a
        local development relay. Never enable this for a device in use.

config LZ_NTP_SERVER
    string "NTP server"
    default "pool.ntp.org"

config LZ_TASK_STACK
    int "Stack of the Lebenszeichen task (bytes)"
    default 12288
    help
        The core needs about 8 KB (channel message, new contact, X25519),
        plus what the application's hooks use (display rendering).

endmenu
```

## firmware/esp-idf/satellite-c6/main/Kconfig.projbuild
```kconfig
menu "Satellite board"

config SAT_PIN_SDA
    int "OLED SDA"
    default 20
config SAT_PIN_SCL
    int "OLED SCL"
    default 19
config SAT_OLED_ADDR
    hex "OLED I2C address"
    default 0x3C
config SAT_PIN_ANSWER
    int "Answer button (to GND)"
    default 18
config SAT_PIN_ASK
    int "Ask button (to GND)"
    default 14
config SAT_PIN_LED
    int "RGB LED (WS2812)"
    default 8
config SAT_TZ
    string "Time zone (POSIX TZ)"
    default "CET-1CEST,M3.5.0,M10.5.0/3"
    help
        Only for showing times; the protocol uses UTC.

endmenu
```
